// SPDX-License-Identifier: GPL-2.0+
/* Initial U-Boot board port; the Linux DTB is a separate artifact. */
#include "../../../dts/upstream/src/arm64/rockchip/rk3308-roc-cc.dts"

/ {
	model = "EPCB IHC-3308GW U-Boot bring-up";
	compatible = "epcb,ihc3308gw", "firefly,roc-rk3308-cc", "rockchip,rk3308";

	chosen {
		stdout-path = "serial4:1500000n8";
	};
};

&uart2 {
	status = "disabled";
};

&uart4 {
	status = "okay";
	pinctrl-names = "default";
	pinctrl-0 = <&uart4_xfer>;
	/delete-property/ uart-has-rtscts;
};

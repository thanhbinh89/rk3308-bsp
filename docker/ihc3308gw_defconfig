## docker/ihc3308gw_defconfig
```kconfig
BR2_aarch64=y
BR2_cortex_a35=y
BR2_JLEVEL=4
BR2_TOOLCHAIN_BUILDROOT=y
BR2_TOOLCHAIN_BUILDROOT_MUSL=y
BR2_KERNEL_HEADERS_VERSION=y
BR2_DEFAULT_KERNEL_VERSION="4.4.143"
BR2_PACKAGE_HOST_LINUX_HEADERS_CUSTOM_4_4=y
BR2_SHARED_LIBS=y
BR2_TARGET_GENERIC_HOSTNAME="ihc3308gw"
BR2_TARGET_GENERIC_ISSUE="EPCB RK3308 BSP - Lab 2"
BR2_INIT_BUSYBOX=y
BR2_PACKAGE_BUSYBOX=y
BR2_ROOTFS_DEVICE_CREATION_DYNAMIC_DEVTMPFS=y
BR2_TARGET_GENERIC_GETTY_PORT="ttyFIQ0"
BR2_TARGET_GENERIC_GETTY_BAUDRATE_KEEP=y
BR2_TARGET_ENABLE_ROOT_LOGIN=y
BR2_TARGET_GENERIC_ROOT_PASSWD=""
BR2_ROOTFS_OVERLAY="$(BR2_EXTERNAL_EPCB_RK3308_PATH)/board/ihc3308gw/overlay"
BR2_TARGET_ROOTFS_CPIO=y
BR2_TARGET_ROOTFS_CPIO_GZIP=y
BR2_TARGET_ROOTFS_EXT2=y
BR2_TARGET_ROOTFS_EXT2_2r1=y
BR2_TARGET_ROOTFS_EXT2_SIZE="128M"
# BR2_TARGET_ROOTFS_TAR is not set
# BR2_LINUX_KERNEL is not set
# BR2_TARGET_UBOOT is not set
```
